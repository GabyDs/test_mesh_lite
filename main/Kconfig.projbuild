## main/Kconfig.projbuild
```kconfig
menu "Mesh Camera Configuration"

choice NODE_ROLE
    prompt "Node Role"
    default NODE_ROLE_CAMERA
    help
        Select the role of this node in the mesh network.

    config NODE_ROLE_ROOT
        bool "Root Node (Gateway/Server)"
        help
            This node will act as the root/gateway that connects to the router
            and receives data from camera nodes.

    config NODE_ROLE_CAMERA
        bool "Camera Node (Leaf)"
        help
            This node will act as a camera that captures and sends images
            through the mesh network to the root node.
endchoice

config ROUTER_SSID
    string "Router SSID"
        default "ROUTER_SSID"
        help
            Router SSID.

config ROUTER_PASSWORD
    string "Router password"
        default "ROUTER_PASSWORD"
        help
            Router password.

endmenu
```

## sdkconfig.defaults.private.example
```kconfig
# WiFi Configuration - COPY THIS FILE TO sdkconfig.defaults.private
# This file should NOT be committed to git
#
# After copying, edit with your actual credentials:
#   cp sdkconfig.defaults.private.example sdkconfig.defaults.private

# Router/External WiFi credentials (the network the root node connects to)
CONFIG_ROUTER_SSID="YOUR_WIFI_SSID"
CONFIG_ROUTER_PASSWORD="YOUR_WIFI_PASSWORD"

# Mesh SoftAP credentials (used for mesh internal communication)
CONFIG_BRIDGE_SOFTAP_SSID="ESP_Bridge"
CONFIG_BRIDGE_SOFTAP_PASSWORD="mesh_password_123"
```
